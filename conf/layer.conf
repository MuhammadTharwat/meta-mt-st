## conf/layer.conf
```bitbake
# We have a conf and classes directory, add to BBPATH
BBPATH .= ":${LAYERDIR}"

# We have recipes-* directories, add to BBFILES
BBFILES += "${LAYERDIR}/recipes-*/*.bb \
            ${LAYERDIR}/recipes-*/*/*.bb \
	        ${LAYERDIR}/recipes-*/*/*/*.bb \
            ${LAYERDIR}/recipes-*/*/*.bbappend \
            ${LAYERDIR}/recipes-*/*/*/*.bbappend"

# BBFILES_DYNAMIC += "\
#     mender:${LAYERDIR}/dynamic-layers/mender/*/*/*.bbappend \
# "

BBFILE_COLLECTIONS += "meta-mt-st"
BBFILE_PATTERN_meta-mt-st= "^${LAYERDIR}/"
BBFILE_PRIORITY_meta-mt-st = "10"

LAYERDEPENDS_meta-mt-st = "core"
LAYERSERIES_COMPAT_meta-mt-st = "scarthgap"
```

## conf/machine/mt-stm32mp157-dk1.conf
```bitbake
# Define specific familly common machine name
MACHINEOVERRIDES =. "stm32mp1common:stm32mp15common:stm32mp13common:"

include conf/machine/include/st-machine-common-stm32mp.inc
include conf/machine/include/st-machine-providers-stm32mp.inc

# =========================================================================
# Chip architecture
# =========================================================================
DEFAULTTUNE = "cortexa7thf-neon-vfpv4"
include conf/machine/include/arm/armv7a/tune-cortexa7.inc

# =========================================================================
# boot scheme
# =========================================================================
#BOOTSCHEME_LABELS += "optee"
BOOTSCHEME_LABELS += "opteemin"
BOOTSCHEME_LABELS += "fastboot"
BOOTSCHEME_LABELS += "fastboot-opteemin"

# =========================================================================
# boot device
# =========================================================================
# Define the boot device supported
BOOTDEVICE_LABELS += "sdcard"

# =========================================================================
# Machine settings
# =========================================================================
# Define list of devicetree per supported storage
STM32MP_DT_FILES_EMMC = ""
STM32MP_DT_FILES_SDCARD = "stm32mp157d-dk1"
STM32MP_DEVICETREE_PROGRAMMER_ENABLE = "1"
# =========================================================================
# Machine features
# =========================================================================
MACHINE_FEATURES += "splashscreen"
MACHINE_FEATURES += "watchdog"
MACHINE_FEATURES += "${@'gpu' if d.getVar('ACCEPT_EULA_'+d.getVar('MACHINE')) == '1' else ''}"
MACHINE_FEATURES += "m4copro"
MACHINE_FEATURES += "usbg0"

# =========================================================================
# Kernel
# =========================================================================
# For eval board: auto-load goodix module (touchscreen module)
# KERNEL_MODULE_AUTOLOAD = "goodix"

# Define the devicetree for Linux A7 examples
# LINUX_A7_EXAMPLES_DT += "stm32mp157d-dk1-a7-examples"

# =========================================================================
# M4 copro
# =========================================================================
# Define the devicetree for M4 example

# =========================================================================
# OPTEE
# =========================================================================


## RAM Disk values
## Kernel Load Address at 16 Mbytes
UBOOT_LOADADDRESS = "0x1000000"
UBOOT_ENTRYPOINT = "0x1000000"

## RAM Disk at 32 Mbytes
UBOOT_RD_LOADADDRESS = "0x2000000"
UBOOT_RD_ENTRYPOINT = "0x2000000"

## DTB at 36 Mbytes
UBOOT_DTB_LOADADDRESS = "0x2400000"


MENDER_DEVICE_TYPE = "${MACHINE}"

# Enable TF-A debug
ST_TF_A_LOG_LEVEL_DEBUG = "20"
#EXTRA_OEMAKE:append:pn-tf-a-stm32mp = " --debug "

# Auto load i2c module
KERNEL_MODULE_AUTOLOAD += "i2c-dev"
WKS_FILE = "rpi0-w.wks"
```

## wic/stm32mp157.wks
```
# short-description: Create Raspberry Pi SD card image
# long-description: Creates a partitioned SD card image for use with
# Raspberry Pi. Boot files are located in the first vfat partition.

part /boot --source bootimg-partition --ondisk mmcblk0 --fstype=vfat --label boot --active --align 1024 --size 32

#part /tester --source rawcopy --ondisk mmcblk0 --sourceparams="file=KERNETL_TESTER"

part / --source rawcopy --label fit_a --sourceparams="file=FIT_PART"

part / --source rawcopy --label fit_b --sourceparams="file=FIT_PART"

part / --source rootfs --ondisk mmcblk0 --label rootfs_a --fstype=ext4 --fixed-size 512M

part / --source rootfs --ondisk mmcblk0 --label rootfs_b --fstype=ext4 --fixed-size 512M

#part /app --source rawcopy --ondisk mmcblk0  --sourceparams="file=APPLICATION" --fixed-size 16M

# Data partition
part / --source rawcopy --label data --fstype=ext4 --sourceparams="file=PERSISTANT_DATA.ext4"
```
